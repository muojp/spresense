## examples/sdcard_test/Kconfig
```kconfig
#
# For a description of the syntax of this configuration file,
# see the file kconfig-language.txt in the NuttX tools repository.
#

config EXAMPLES_SDCARD_TEST
	bool "Hello, World! example"
	default n
	---help---
		Enable SDCARD R/W example

if EXAMPLES_SDCARD_TEST

config EXAMPLES_SDCARD_TEST_PROGNAME
	string "Program name"
	default "sdcard_test"
	depends on BUILD_KERNEL
	---help---
		This is the name of the program that will be use when the NSH ELF
		program is installed.

config EXAMPLES_SDCARD_TEST_PRIORITY
	int "SdcardTest task priority"
	default 100

config EXAMPLES_SDCARD_TEST_STACKSIZE
	int "SdcardTest stack size"
	default 2048

endif
```
